## meta-delta/meta-ddt32c2s/conf/layer.conf
```bitbake
# We have a conf and classes directory, add to BBPATH
BBPATH .= ":${LAYERDIR}"

# We have recipes-* directories, add to BBFILES
BBFILES += "${LAYERDIR}/recipes-*/*/*.bb \
	${LAYERDIR}/recipes-*/*/*.bbappend"

BBFILE_COLLECTIONS += "ddt32c2s"
BBFILE_PATTERN_ddt32c2s = "^${LAYERDIR}/"
BBFILE_PRIORITY_ddt32c2s = "20"
LAYERSERIES_COMPAT_ddt32c2s = "kirkstone dunfell"
```

## meta-delta/meta-ddt32c2s/conf/local.conf.sample
```bitbake
#
# Local configuration file for building the OpenBMC image.
#

# Machine Selection
MACHINE ??= "ddt32c2s"

# OpenBMC distro settings
DISTRO ?= "openbmc-delta"
```

## meta-delta/meta-ddt32c2s/conf/machine/ddt32c2s.conf
```bitbake
#@TYPE: Machine
#@NAME: DDT32C2S
#@DESCRIPTION: Machine configuration for Delta DDT32C2S

require conf/machine/include/ast2620.inc

UBOOT_MACHINE:ddt32c2s = "ddt32c2s_defconfig"
UBOOT_CONFIG_BASE = "fbobmc-ast-g6_defconfig"

PREFERRED_VERSION_u-boot = "v2019.04%"
PREFERRED_VERSION_u-boot-fw-utils = "v2019.04%"
PREFERRED_VERSION_u-boot-fw-utils-cross = "v2019.04%"
PREFERRED_VERSION_u-boot-tools = "v2019.04%"
PREFERRED_VERSION_u-boot-tools-native = "v2019.04%"
PREFERRED_VERSION_nativesdk-u-boot-tools = "v2019.04%"

KERNEL_IMAGETYPE = "zImage"
KERNEL_DEVICETREE = "aspeed-bmc-delta-ddt32c2s.dtb"

PREFERRED_VERSION_linux-aspeed = "5.10.%"
PREFERRED_VERSION_libwatchdog = "0.2"
PREFERRED_VERSION_libipmi = "0.2"
PREFERRED_VERSION_ipmid = "0.2"
PREFERRED_VERSION_rest-api = "0.1"
PREFERRED_VERSION_at93cx6-util = "0.1"
PREFERRED_VERSION_fscd = "0.3"
PREFERRED_VERSION_openbmc-gpio = "0.2"

MACHINE_ESSENTIAL_EXTRA_RDEPENDS += "           \
    kernel-module-i2c-dev-sysfs                 \
    kernel-module-i2c-dev-psu                   \
    kernel-module-i2c-dev-sysfpga               \
    kernel-module-cpld                          \
    kernel-module-i2c                           \
    "

require conf/machine/include/tpm2.inc

SERIAL_CONSOLES += "115200;ttyS4"
EXTRA_IMAGE_FEATURES_append = " image-meta "
FW_ENV_CONFIG_FILE = "fw_env.config.64k"
```

## meta-delta/meta-ddt32c2s/recipes-bsp/u-boot/files/ddt32c2s_defconfig
```kconfig
# Target
CONFIG_TARGET_FB_AST_GEN_6=y
CONFIG_SYS_CONFIG_NAME="ddt32c2s"
CONFIG_DEFAULT_DEVICE_TREE="ddt32c2s"

# ARCH choices
CONFIG_ARM=y
CONFIG_ARCH_ASPEED=y
CONFIG_ASPEED_AST2600=y
CONFIG_ARCH_AST2600=y
CONFIG_ASPEED_TPM=n

# common configuration
CONFIG_DM_RESET=y
CONFIG_BAUDRATE=115200
CONFIG_NR_DRAM_BANKS=1
CONFIG_SYS_NS16550=y
CONFIG_CMD_IMI=y
CONFIG_OF_LIBFDT=y
CONFIG_OF_CONTROL=y
# CONFIG_OF_EMBED=y use for debug only
CONFIG_OF_SEPARATE=y
CONFIG_FIT=y
CONFIG_FIT_VERBOSE=y
CONFIG_FIT_SIGNATURE=y
CONFIG_DM=y
CONFIG_DM_I2C=y
CONFIG_CMD_I2C=y
CONFIG_MISC=y
# CONFIG_TPM=y use for TPM support platform, will be selected by ASPEED_TPM
CONFIG_CMD_TPM=y
# CONFIG_TIMER=y
# CONFIG_DISPLAY_CPUINFO is not set

# Migrate to upstream
CONFIG_CLK=y
CONFIG_WDT=y
CONFIG_WDT_ASPEED=y
CONFIG_SYSRESET=y
CONFIG_AST_TIMER=y
CONFIG_SPI=y
CONFIG_DM_SPI=y
CONFIG_SPI_FLASH=y
CONFIG_DM_SPI_FLASH=y
CONFIG_SPI_FLASH_MTD=y
CONFIG_SPI_FLASH_MACRONIX=y
CONFIG_SPI_FLASH_WINBOND=y
CONFIG_CMD_SF=y

CONFIG_DM_ETH=y
CONFIG_FTGMAC100=y
CONFIG_PHY=y
CONFIG_PHYLIB=y
CONFIG_PHY_GIGE=y
CONFIG_PHY_BROADCOM=y
CONFIG_PINCTRL=y
CONFIG_DM_GPIO=y
CONFIG_ASPEED_GPIO=y


# Delta Extra
CONFIG_SYS_TEXT_BASE=0x0
CONFIG_SPI_BOOT=y
CONFIG_HUSH_PARSER=y
# CONFIG_NETCONSOLE=y
CONFIG_NETDEVICES=y
CONFIG_DEBUG_UART=y
CONFIG_DEBUG_UART_BASE=0x1E784000
CONFIG_DEBUG_UART_CLOCK=24000000
CONFIG_BOOTDELAY=5
CONFIG_SYS_PROMPT="ddt32c2s-boot=> "
CONFIG_ASPEED_ENABLE_DUAL_BOOT_WATCHDOG=y

# "image-meta" partition is introduced in IMG_LAYOUT_V1, and meanwhile
# u-boot-env size is decreased to 64KB.
CONFIG_FBOBMC_IMG_LAYOUT_VER=1

# Enable write default environment
CONFIG_ASPEED_WRITE_DEFAULT_ENV=y

# Disabled commands (save space)
CONFIG_CMD_IMLS=n
CONFIG_CMD_FDT=y
CONFIG_CMD_ELF=n
CONFIG_CMD_XIMG=n
# CONFIG_CMD_NET=n
CONFIG_EFI_LOADER=y
CONFIG_CMD_FPGA=n
CONFIG_CMD_SETEXPR=n

# debug
CONFIG_LOGLEVEL=7

# Extra
CONFIG_CMD_DRAMTEST=n
CONFIG_RAM=y
CONFIG_DM_SERIAL=y
CONFIG_CMD_FLASH=n
CONFIG_SPL_SYS_MALLOC_F_LEN=0x3000

CONFIG_ASPEED_TPM=n
CONFIG_SYS_DCACHE_OFF=y
CONFIG_SPL_LDSCRIPT="board/fb-obmc/ast/vboot-spl.lds"
# CONFIG_ASPEED_LOADERS is not set
CONFIG_SYS_MALLOC_F_LEN=0x3000
# CONFIG_SPL_MMC_SUPPORT=y
# CONFIG_ENV_SIZE=0x10000
# CONFIG_ENV_OFFSET=0xE0000
# CONFIG_SPL_STACK_R_ADDR=0x90300000
CONFIG_ARMV7_BOOT_SEC_DEFAULT=y
CONFIG_USE_BOOTARGS=y
# CONFIG_USE_BOOTCOMMAND=y
# CONFIG_BOOTCOMMAND="bootm 201A0000"
CONFIG_SYS_CONSOLE_ENV_OVERWRITE=y
CONFIG_DISPLAY_BOARDINFO_LATE=y
CONFIG_ARCH_EARLY_INIT_R=y
# CONFIG_BOARD_EARLY_INIT_F=y
# CONFIG_SPL_RAW_IMAGE_SUPPORT is not set
# CONFIG_SPL_LEGACY_IMAGE_SUPPORT is not set
# CONFIG_SPL_SYS_MALLOC_SIMPLE=y
# CONFIG_SPL_STACK_R=y
# CONFIG_SPL_SEPARATE_BSS=y
# CONFIG_SPL_DM_RESET=y
# CONFIG_SPL_YMODEM_SUPPORT=y
# CONFIG_AUTO_COMPLETE is not set
CONFIG_CMD_MEMTEST=y
CONFIG_SYS_ALT_MEMTEST=y
CONFIG_CMD_CLK=y
CONFIG_CMD_GPIO=y
# CONFIG_CMD_MMC=y
CONFIG_CMD_PART=y
# CONFIG_CMD_PCI=y
CONFIG_CMD_USB=y
CONFIG_CMD_DHCP=y
CONFIG_CMD_MII=y
CONFIG_CMD_PING=y
CONFIG_CMD_EXT2=y
CONFIG_CMD_EXT4=y
CONFIG_CMD_EXT4_WRITE=y
CONFIG_CMD_FAT=y
CONFIG_CMD_FS_GENERIC=y
CONFIG_CMD_MTDPARTS=y
# CONFIG_ENV_IS_IN_SPI_FLASH=y
# CONFIG_USE_ENV_SPI_BUS=y
# CONFIG_ENV_SPI_BUS=0
# CONFIG_USE_ENV_SPI_CS=y
# CONFIG_ENV_SPI_CS=0
# CONFIG_USE_ENV_SPI_MAX_HZ=y
# CONFIG_ENV_SPI_MAX_HZ=100000000
CONFIG_NET_RANDOM_ETHADDR=y
CONFIG_REGMAP=y
CONFIG_SYSCON=y
CONFIG_SYS_I2C_ASPEED=y
CONFIG_ASPEED_AHBC=y
# CONFIG_ASPEED_H2X=y
# CONFIG_DM_MMC=y
# CONFIG_SPL_MMC_TINY=y
# CONFIG_MMC_SDHCI=y
# CONFIG_MMC_SDHCI_ASPEED=y
CONFIG_SPI_FLASH_SFDP_SUPPORT=y
CONFIG_SPI_FLASH_GIGADEVICE=y
CONFIG_SPI_FLASH_ISSI=y
CONFIG_SPI_FLASH_SPANSION=y
CONFIG_SPI_FLASH_STMICRO=y
CONFIG_PHY_REALTEK=y
CONFIG_MDIO=y
# CONFIG_PCI=y
# CONFIG_DM_PCI=y
# CONFIG_PCIE_ASPEED=y
# CONFIG_SPL_RAM=y
CONFIG_ASPEED_ECC=y
CONFIG_TEE=y
CONFIG_USB=y
CONFIG_DM_USB=y
CONFIG_USB_EHCI_HCD=y
CONFIG_USB_STORAGE=y
# CONFIG_USE_TINY_PRINTF=y

CONFIG_RSA=y
CONFIG_FIT_SIGNATURE=y

# SPL (ROM) feature configuration
# CONFIG_SPL=y
CONFIG_SPL_FIT=y
CONFIG_SPL_TINY_FIT=y
CONFIG_SPL_LOAD_FIT=y
CONFIG_SPL_DM=y
CONFIG_SPL_OF_CONTROL=y
CONFIG_SPL_OF_LIBFDT=y
CONFIG_SPL_OF_TRANSLATE=y
CONFIG_SPL_FIT_SIGNATURE=y
CONFIG_SPL_WATCHDOG_SUPPORT=y
CONFIG_SPL_DRIVERS_MISC_SUPPORT=y
CONFIG_SPL_CLK=y
CONFIG_SPL_SPI_SUPPORT=y
CONFIG_SPL_GPIO_SUPPORT=y
CONFIG_SPL_PINCTRL=y
CONFIG_SPL_LIBGENERIC_SUPPORT=y
CONFIG_SPL_LIBCOMMON_SUPPORT=y
CONFIG_SPL_SERIAL_SUPPORT=y
CONFIG_SPL_I2C_SUPPORT=y
CONFIG_SPL_CRYPTO_SUPPORT=y
CONFIG_SPL_RSA=y
CONFIG_SPL_HASH_SUPPORT=y
CONFIG_SPL_SHA256_SUPPORT=y
CONFIG_SPL_SHA256=y
CONFIG_SPL_SHA1=y
CONFIG_SPL_TPM=y

# TPM2 support
# CONFIG_TPM=y will be selected by ASPEED_TPM
CONFIG_CMD_TPM=y
CONFIG_TPM_V1=n
CONFIG_TPM_V2=y
CONFIG_TPM2_TIS_SPI=y

# use SOFT_SPI
CONFIG_PINCTRL=y
CONFIG_SOFT_SPI=y

# Enable commands
CONFIG_CMD_TPM_V2=y

# Leave this commented (build-step feature)
# CONFIG_ASPEED_RECOVERY_BUILD=y

# facebook common
CONFIG_AUTOBOOT_PROMPT="autoboot in %d seconds (stop with 'Delete' key)...\n"
# 'Delete', ESC[3~
CONFIG_AUTOBOOT_STOP_STR="\x1b\x5b\x33\x7e"
CONFIG_AUTOBOOT_KEYED=y

# CONFIG_BOOTARGS
CONFIG_BOOTARGS="debug console=ttyS4,115200n8 root=/dev/ram rw"
```
